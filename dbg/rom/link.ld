/* SPDX-License-Identifier: Apache-2.0
 * Adapted from PULP riscv-dbg debug_rom/link.ld at
 * 643607e19df3435cfd77cc56143e2637f5900a6e; original SiFive ROM layout.
 * See ../LICENSE.SiFive. Only .text is emitted; WHERETO is generated by DM.
 */
OUTPUT_ARCH(riscv)
ENTRY(entry)
SECTIONS
{
    . = 0x800;
    .text : { *(.text) }
    /DISCARD/ : { *(.riscv.attributes) *(.comment) }
}
